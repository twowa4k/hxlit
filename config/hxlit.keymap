/ {
    keymap {
        compatible = "zmk,keymap";

        default_layer {
            bindings = <&kp A &kp B &kp C &kp D>;
            sensor-bindings = <&inc_dec_kp C_VOL_UP C_VOL_DN>;
        };
    };
};
